## board/qca/ap151/Kconfig
```kconfig
if TARGET_AP151

config SYS_VENDOR
	default "qca"

config SYS_BOARD
	default "ap151"

config SYS_CONFIG_NAME
	default "ap151"

config TEXT_BASE
	default 0x80010000

endif
```
